// SPDX-License-Identifier: GPL-2.0-only

#include "common/volume-keys.dtsi"
#include "common/memory.dtsi"
#include "common/waipio-peripherals.dtsi"
#include "common/waipio-thermal.dtsi"
#include "common/waipio-audio.dtsi"
